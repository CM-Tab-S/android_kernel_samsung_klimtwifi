## arch/arm/configs/exynos5420_mmi_chagalllte_defconfig
```kconfig
#
# Sensors
#
CONFIG_MOTOR_DRV_MAX77803=y
# CONFIG_HAPTIC_ISA1200 is not set
# CONFIG_SENSORS_AK8963C is not set
CONFIG_SENSORS_AK09911C=y
CONFIG_SENSORS_CM3323=y
# CONFIG_SENSORS_TMD3782 is not set
CONFIG_SENSORS_ESD_DEFENCE=y
CONFIG_SENSORS_SX9500=y
CONFIG_SENSORS_SX9500_INIT_TOUCH_THRESHOLD=3000
CONFIG_SENSORS_SX9500_NORMAL_TOUCH_THRESHOLD=10

#
# Enable Modem
#
CONFIG_SEC_MODEM_XMM6360=y
# CONFIG_SEC_MODEM_XMM6262 is not set
CONFIG_UMTS_MODEM_XMM6360=y
# CONFIG_UMTS_MODEM_XMM6262 is not set
# CONFIG_CDMA_MODEM_MDM6600 is not set
# CONFIG_GSM_MODEM_ESC6270 is not set
# CONFIG_LINK_DEVICE_PLD is not set
CONFIG_LINK_DEVICE_HSIC=y
CONFIG_SIM_DETECT=y
# CONFIG_SIM_SLOT_SWITCH is not set
# CONFIG_PHY_HSIC_TUNE1 is not set
CONFIG_SEC_MODEM=y
CONFIG_SEC_MODEM_V2=y
CONFIG_PHY_HSIC_TUNE1=y
CONFIG_PHY_HSIC_TUNE1_REG=0xFC
# CONFIG_UMTS_MODEM_XMM6260 is not set
# CONFIG_LINK_ETHERNET is not set
CONFIG_EHCI_IRQ_DISTRIBUTION=y
CONFIG_EHCI_MODEM_PORTNUM=2

#
# Display Driver
#
CONFIG_LCD_MIPI_S6TNMR7=y
# CONFIG_LCD_MIPI_S6E3HA1 is not set
# CONFIG_LCD_LSL122DL01 is not set
# CONFIG_LCD_LSL122DL01_BATTERY is not set
# CONFIG_TOUCHSCREEN_ATMEL_MXTS is not set
# CONFIG_TOUCHSCREEN_ATMEL_MXT1664S is not set
# CONFIG_TOUCHSCREEN_ATMEL_MXT1664T is not set
CONFIG_TOUCHSCREEN_SYNAPTICS_I2C_DSX=y
CONFIG_TOUCHSCREEN_SYNAPTICS_WAKE_GESTURES=y
# CONFIG_INPUT_WACOM is not set
# CONFIG_EPEN_WACOM_G9PLL is not set
# CONFIG_BACKLIGHT_LP855X is not set

#
# MHL
#
CONFIG_MHL_VERSION=0x21

#
# Fingerprint
#
CONFIG_SENSORS_FINGERPRINT=y
CONFIG_SENSORS_FINGERPRINT_SYSFS=y
CONFIG_SENSORS_VFS61XX=y
CONFIG_SENSORS_VFS61XX_KO=y
CONFIG_SENSORS_FP_SPI_NUMBER=1
# CONFIG_SENSORS_FPRINT_SECURE is not set

#
# Camera
#
CONFIG_CAMERA_EEPROM=y

#
# GPS
#
# CONFIG_GPS_BCM47521 is not set
CONFIG_GPS_BCM47531=y

#
# MUIC
#
CONFIG_MUIC_FULL_DUMP_ENABLE=y
CONFIG_MUIC_MAX77888_ONESHOT=y

#
# MFD
#
CONFIG_MFD_MAX77802 is not set
CONFIG_MFD_SEC_CORE=y
CONFIG_REGULATOR_S2MPS11=y
CONFIG_REGULATOR_S2ABB01=y
# CONFIG_REGULATOR_MAX77802 is not set

#
# MDNIE Lite/Regular
#
CONFIG_FB_MIPI_DSIM=y
# CONFIG_FB_I80IF is not set
CONFIG_FB_HW_TRIGGER=y
# CONFIG_FB_S5P_MDNIE is not set
CONFIG_FB_S5P_MDNIE_LITE=y
# CONFIG_FB_DBLC_PWM is not set
CONFIG_FB_MIC=y
# CONFIG_S5P_DP is not set
CONFIG_S5P_DEV_MIPI_DSIM1=y

#
# I2C RTC drivers
#
# CONFIG_RTC_DRV_MAX77802 is not set

#
# Touchkey Drivers
#
CONFIG_KEYBOARD_TC300K=y
# CONFIG_KEYBOARD_CYPRESS_TOUCH is not set

#
# Wifi Drivers
#
# CONFIG_BCM4339 is not set
CONFIG_BCM4354=y
# CONFIG_CFG80211_REG_NOT_UPDATED is not set

#
# US or EUR
#
CONFIG_TARGET_LOCALE_EUR=y
# CONFIG_TARGET_LOCALE_USA is not set

#
# Klimt
#
# CONFIG_KLIMT is not set
# CONFIG_KLIMT_WIFI is not set
# CONFIG_KLIMT_LTE is not set

#
# Chagall
#
CONFIG_CHAGALL=y
# CONFIG_CHAGALL_WIFI is not set
CONFIG_CHAGALL_LTE=y

#
# V1A
#
# CONFIG_V1A is not set
# CONFIG_V1A_WIFI is not set

#
# N1A
#
# CONFIG_N1A is not set
# CONFIG_N1A_WIFI is not set
```

## arch/arm/configs/exynos5420_mmi_klimtwifi_defconfig
```kconfig
#
# Sensors
#
CONFIG_MOTOR_DRV_MAX77803=y
# CONFIG_HAPTIC_ISA1200 is not set
# CONFIG_SENSORS_AK8963C is not set
CONFIG_SENSORS_AK09911C=y
CONFIG_SENSORS_CM3323=y
# CONFIG_SENSORS_TMD3782 is not set
# CONFIG_SENSORS_ESD_DEFENCE is not set
CONFIG_SENSORS_SX9500=y
CONFIG_SENSORS_SX9500_INIT_TOUCH_THRESHOLD=8000
CONFIG_SENSORS_SX9500_NORMAL_TOUCH_THRESHOLD=9

#
# Disable Modem
#
# CONFIG_SEC_MODEM_V2 is not set
# CONFIG_SIM_DETECT is not set

#
# Display Drivers
#
# CONFIG_LCD_MIPI_S6TNMR7 is not set
CONFIG_LCD_MIPI_S6E3HA1=y
# CONFIG_LCD_LSL122DL01 is not set
# CONFIG_LCD_LSL122DL01_BATTERY is not set
# CONFIG_TOUCHSCREEN_ATMEL_MXTS is not set
# CONFIG_TOUCHSCREEN_ATMEL_MXT1664S is not set
CONFIG_TOUCHSCREEN_ATMEL_MXT1664T=y
CONFIG_TOUCHSCREEN_SYNAPTICS_I2C_DSX=y
CONFIG_TOUCHSCREEN_SYNAPTICS_WAKE_GESTURES=y
# CONFIG_INPUT_WACOM is not set
# CONFIG_EPEN_WACOM_G9PLL is not set
# CONFIG_BACKLIGHT_LP855X is not set

#
# MHL
#
CONFIG_MHL_VERSION=0x21

#
# Fingerprint
#
CONFIG_SENSORS_FINGERPRINT=y
CONFIG_SENSORS_FINGERPRINT_SYSFS=y
CONFIG_SENSORS_VFS61XX=y
CONFIG_SENSORS_VFS61XX_KO=y
CONFIG_SENSORS_FP_SPI_NUMBER=1
# CONFIG_SENSORS_FPRINT_SECURE is not set

#
# Camera
#
CONFIG_CAMERA_EEPROM=y

#
# GPS
#
# CONFIG_GPS_BCM47521 is not set
CONFIG_GPS_BCM47531=y

#
# MUIC
#
CONFIG_MUIC_FULL_DUMP_ENABLE=y
CONFIG_MUIC_MAX77888_ONESHOT=y

#
# MFD
#
CONFIG_MFD_MAX77802 is not set
CONFIG_MFD_SEC_CORE=y
CONFIG_REGULATOR_S2MPS11=y
CONFIG_REGULATOR_S2ABB01=y
# CONFIG_REGULATOR_MAX77802 is not set

#
# MDNIE Lite/Regular
#
CONFIG_FB_MIPI_DSIM=y
# CONFIG_FB_I80IF is not set
CONFIG_FB_HW_TRIGGER=y
# CONFIG_FB_S5P_MDNIE is not set
CONFIG_FB_S5P_MDNIE_LITE=y
# CONFIG_FB_DBLC_PWM is not set
CONFIG_FB_MIC=y
# CONFIG_S5P_DP is not set
CONFIG_S5P_DEV_MIPI_DSIM1=y

#
# I2C RTC drivers
#
# CONFIG_RTC_DRV_MAX77802 is not set

#
# Touchkey Drivers
#
# CONFIG_KEYBOARD_TC300K is not set
CONFIG_KEYBOARD_CYPRESS_TOUCH=y

#
# Wifi Drivers
#
# CONFIG_BCM4339 is not set
CONFIG_BCM4354=y
# CONFIG_CFG80211_REG_NOT_UPDATED is not set

#
# US or EUR
#
# CONFIG_TARGET_LOCALE_EUR is not set
CONFIG_TARGET_LOCALE_USA=y

#
# Klimt
#
CONFIG_KLIMT=y
CONFIG_KLIMT_WIFI=y
# CONFIG_KLIMT_LTE is not set

#
# Chagall
#
# CONFIG_CHAGALL is not set
# CONFIG_CHAGALL_WIFI is not set
# CONFIG_CHAGALL_LTE is not set

#
# V1A
#
# CONFIG_V1A is not set
# CONFIG_V1A_WIFI is not set

#
# N1A
#
# CONFIG_N1A is not set
# CONFIG_N1A_WIFI is not set
```

## arch/arm/configs/exynos5420_mmi_n1awifi_defconfig
```kconfig
#
# Sensors
#
CONFIG_MOTOR_DRV_MAX77803=y
# CONFIG_HAPTIC_ISA1200 is not set
CONFIG_SENSORS_AK8963C=y
# CONFIG_SENSORS_AK09911C is not set
CONFIG_SENSORS_CM3323=y
# CONFIG_SENSORS_TMD3782 is not set
# CONFIG_SENSORS_ESD_DEFENCE is not set
CONFIG_SENSORS_SX9500=y
CONFIG_SENSORS_SX9500_INIT_TOUCH_THRESHOLD=3000
CONFIG_SENSORS_SX9500_NORMAL_TOUCH_THRESHOLD=17

#
# Disable Modem
#
# CONFIG_SEC_MODEM_V2 is not set
# CONFIG_SIM_DETECT is not set

#
# Display Driver
#
# CONFIG_LCD_MIPI_S6TNMR7 is not set
# CONFIG_LCD_MIPI_S6E3HA1 is not set
CONFIG_LCD_LSL122DL01=y
# CONFIG_LCD_LSL122DL01_BATTERY is not set
CONFIG_TOUCHSCREEN_ATMEL_MXTS=y
CONFIG_TOUCHSCREEN_ATMEL_MXT1664S=y
# CONFIG_TOUCHSCREEN_ATMEL_MXT1664T is not set
# CONFIG_TOUCHSCREEN_SYNAPTICS_I2C_DSX is not set
# CONFIG_TOUCHSCREEN_SYNAPTICS_WAKE_GESTURES is not set
CONFIG_INPUT_WACOM=y
CONFIG_EPEN_WACOM_G9PLL=y
CONFIG_BACKLIGHT_LP855X=y

#
# MHL
#
CONFIG_MHL_VERSION=0x20

#
# Fingerprint
#
# CONFIG_SENSORS_FINGERPRINT is not set
# CONFIG_SENSORS_FINGERPRINT_SYSFS is not set
# CONFIG_SENSORS_VFS61XX is not set
# CONFIG_SENSORS_VFS61XX_KO is not set
# CONFIG_SENSORS_FP_SPI_NUMBER is not set
# CONFIG_SENSORS_FPRINT_SECURE is not set

#
# Camera
#
# CONFIG_CAMERA_EEPROM is not set

#
# GPS
#
CONFIG_GPS_BCM47521=y
# CONFIG_GPS_BCM47531 is not set

#
# MUIC
#
# CONFIG_MUIC_FULL_DUMP_ENABLE is not set
# CONFIG_MUIC_MAX77888_ONESHOT is not set

#
# MFD
#
CONFIG_MFD_MAX77802=y
# CONFIG_MFD_SEC_CORE is not set
# CONFIG_REGULATOR_S2MPS11 is not set
# CONFIG_REGULATOR_S2ABB01 is not set
CONFIG_REGULATOR_MAX77802=y

#
# MDNIE Lite/Regular
#
# CONFIG_FB_MIPI_DSIM is not set
# CONFIG_FB_I80IF is not set
# CONFIG_FB_HW_TRIGGER is not set
CONFIG_FB_S5P_MDNIE=y
# CONFIG_FB_S5P_MDNIE_LITE is not set
CONFIG_FB_DBLC_PWM=y
# CONFIG_FB_MIC is not set
CONFIG_S5P_DP=y
CONFIG_S5P_DP_PSR=y
CONFIG_S5P_DP_ESD_RECOVERY=y
# CONFIG_S5P_DEV_MIPI_DSIM1 is not set

#
# I2C RTC drivers
#
CONFIG_RTC_DRV_MAX77802=y

#
# Touchkey Drivers
#
# CONFIG_KEYBOARD_TC300K is not set
# CONFIG_KEYBOARD_CYPRESS_TOUCH is not set

#
# Wifi Drivers
#
CONFIG_BCM4339=y
# CONFIG_BCM4354 is not set
# CONFIG_CFG80211_REG_NOT_UPDATED is not set

#
# US or EUR
#
CONFIG_TARGET_LOCALE_EUR=y
# CONFIG_TARGET_LOCALE_USA is not set

#
# Klimt
#
# CONFIG_KLIMT is not set
# CONFIG_KLIMT_WIFI is not set
# CONFIG_KLIMT_LTE is not set

#
# Chagall
#
# CONFIG_CHAGALL is not set
# CONFIG_CHAGALL_WIFI is not set
# CONFIG_CHAGALL_LTE is not set

#
# V1A
#
# CONFIG_V1A is not set
# CONFIG_V1A_WIFI is not set

#
# N1A
#
CONFIG_N1A=y
CONFIG_N1A_WIFI=y
```
